## Kconfig
```kconfig
# SPDX-FileCopyrightText: 2026 roolrz
# SPDX-License-Identifier: Apache-2.0

mainmenu "HypeR System Configuration"

# Kernel settings have an independent schema and output (kernel/.config).
# The root menu opens that editor without copying its symbols here.
source "bootstrap/stage1/Kconfig"
source "app/Kconfig"
source "svc/Kconfig"
source "tests/app/Kconfig"

menu "Build policy"

config KERNEL_FEATURES
    string "Kernel feature override (advanced)"
    default "default"
    help
        Normally leave this at default and use the Kernel submenu. default
        follows kernel/.config (or the architecture defconfig). An explicit
        comma-separated production feature list replaces that feature selection;
        empty disables optional features. Numeric kernel settings remain in
        kernel/.config. Test features are rejected here.

config BOOT_POLICY
    string "Boot policy file"
    default ""
    help
        Optional repository-relative or absolute JSON path with boot-profiles
        and storage-providers. Empty follows the board policy. Runtime policy
        cannot select applications or kernel features.

endmenu
```

## app/Kconfig
```kconfig
# SPDX-FileCopyrightText: 2026 roolrz
# SPDX-License-Identifier: Apache-2.0

menu "System / Applications"

config SYSTEM_APP_CAT
    bool "cat (/bin/cat)"
    default y
    help
        Build and deploy hyper-cat at /bin/cat.

config SYSTEM_APP_CHMOD
    bool "chmod (/bin/chmod)"
    default y
    help
        Build and deploy hyper-chmod at /bin/chmod.

config SYSTEM_APP_COMPONENTCTL
    bool "componentctl (/bin/componentctl)"
    default y
    depends on SYSTEM_APP_COMPONENT_MANAGER
    help
        Build and deploy hyper-componentctl at /bin/componentctl.

config SYSTEM_APP_CP
    bool "cp (/bin/cp)"
    default y
    help
        Build and deploy hyper-cp at /bin/cp.

config SYSTEM_APP_ECHO
    bool "echo (/bin/echo)"
    default y
    help
        Build and deploy hyper-echo at /bin/echo.

config SYSTEM_APP_EDITOR
    bool "editor (/bin/editor)"
    default y
    depends on SYSTEM_APP_TERMINAL_SERVICE
    help
        Build and deploy hyper-editor at /bin/editor.

config SYSTEM_APP_FREE
    bool "free (/bin/free)"
    default y
    help
        Build and deploy hyper-free at /bin/free.

config SYSTEM_APP_GREP
    bool "grep (/bin/grep)"
    default y
    help
        Build and deploy hyper-grep at /bin/grep.

config SYSTEM_APP_HANDLE
    bool "handle (/bin/handle)"
    default y
    help
        Build and deploy hyper-handle at /bin/handle.

config SYSTEM_APP_JOURNALCTL
    bool "journalctl (/bin/journalctl)"
    default y
    depends on SYSTEM_APP_SVC_JOURNAL
    help
        Build and deploy hyper-journalctl at /bin/journalctl.

config SYSTEM_APP_LDD
    bool "ldd (/bin/ldd)"
    default y
    help
        Build and deploy hyper-ldd at /bin/ldd.

config SYSTEM_APP_LESS
    bool "less (/bin/less)"
    default y
    help
        Build and deploy hyper-less at /bin/less.

config SYSTEM_APP_LN
    bool "ln (/bin/ln)"
    default y
    help
        Build and deploy hyper-ln at /bin/ln.

config SYSTEM_APP_LS
    bool "ls (/bin/ls)"
    default y
    help
        Build and deploy hyper-ls at /bin/ls.

config SYSTEM_APP_MEMSTAT
    bool "memstat (/bin/memstat)"
    default y
    help
        Build and deploy hyper-memstat at /bin/memstat.

config SYSTEM_APP_MKDIR
    bool "mkdir (/bin/mkdir)"
    default y
    help
        Build and deploy hyper-mkdir at /bin/mkdir.

config SYSTEM_APP_MOUNT_SYSTEM
    bool "mount-system (/bin/mount)"
    default y
    depends on SYSTEM_APP_FS_BACKEND_SYSTEM
    help
        Build and deploy hyper-mount-system at /bin/mount.

config SYSTEM_APP_MV
    bool "mv (/bin/mv)"
    default y
    help
        Build and deploy hyper-mv at /bin/mv.

config SYSTEM_APP_PERF
    bool "perf (/bin/perf)"
    default y
    help
        Build and deploy hyper-perf at /bin/perf.

config SYSTEM_APP_PS
    bool "ps (/bin/ps)"
    default y
    help
        Build and deploy hyper-ps at /bin/ps.

config SYSTEM_APP_RM
    bool "rm (/bin/rm)"
    default y
    help
        Build and deploy hyper-rm at /bin/rm.

config SYSTEM_APP_RMDIR
    bool "rmdir (/bin/rmdir)"
    default y
    help
        Build and deploy hyper-rmdir at /bin/rmdir.

config SYSTEM_APP_SH
    bool "sh (/bin/sh)"
    default y
    help
        Build and deploy hyper-shell at /bin/sh.

config SYSTEM_APP_TOP
    bool "top (/bin/top)"
    default y
    help
        Build and deploy hyper-top at /bin/top.

config SYSTEM_APP_TOUCH
    bool "touch (/bin/touch)"
    default y
    help
        Build and deploy hyper-touch at /bin/touch.

config SYSTEM_APP_UMOUNT_SYSTEM
    bool "umount-system (/bin/umount)"
    default y
    depends on SYSTEM_APP_FS_BACKEND_SYSTEM
    help
        Build and deploy hyper-umount-system at /bin/umount.

config SYSTEM_APP_VMM
    bool "vmm (/bin/vmm)"
    default y
    depends on SYSTEM_APP_VM_MANAGER
    help
        Build and deploy hyper-vmm at /bin/vmm.

endmenu
```

## svc/Kconfig
```kconfig
# SPDX-FileCopyrightText: 2026 roolrz
# SPDX-License-Identifier: Apache-2.0

menu "System / Services"

config SYSTEM_APP_COMPONENT_MANAGER
    bool "component-manager (/svc/component-manager)"
    default y
    help
        Build and deploy hyper-component-manager at /svc/component-manager.
        Startup coordinator and service topology come from the selected profile.

config SYSTEM_APP_CONSOLE_RAW_SYSTEM
    bool "console-raw-system (/svc/console-raw)"
    default y
    depends on SYSTEM_APP_COMPONENT_MANAGER
    help
        Build and deploy hyper-console-raw-system at /svc/console-raw.

config SYSTEM_APP_FS_BACKEND_SYSTEM
    bool "fs-backend-system (/svc/fs-backend)"
    default y
    depends on SYSTEM_APP_COMPONENT_MANAGER
    help
        Build and deploy hyper-fs-backend-system at /svc/fs-backend.

config SYSTEM_APP_FS_EROFS_SYSTEM
    bool "fs-erofs-system (/svc/fs-erofs)"
    default y
    depends on SYSTEM_APP_FS_BACKEND_SYSTEM
    help
        Build and deploy hyper-fs-erofs-system at /svc/fs-erofs.

config SYSTEM_APP_FS_FAT_SYSTEM
    bool "fs-fat-system (/svc/fs-fat)"
    default y
    depends on SYSTEM_APP_FS_BACKEND_SYSTEM
    help
        Build and deploy hyper-fs-fat-system at /svc/fs-fat.

config SYSTEM_APP_IO_RUNTIME_SYSTEM
    bool "io-runtime-system (/svc/io-runtime)"
    default y
    depends on SYSTEM_APP_COMPONENT_MANAGER
    help
        Build and deploy hyper-io-runtime-system at /svc/io-runtime.

config SYSTEM_APP_SESSION_MANAGER
    bool "session-manager (/svc/session-manager)"
    default y
    depends on SYSTEM_APP_TERMINAL_SERVICE && SYSTEM_APP_SH && SYSTEM_APP_COMPONENT_MANAGER && SYSTEM_APP_SVC_JOURNAL
    help
        Build and deploy hyper-session-manager at /svc/session-manager.

config SYSTEM_APP_SVC_BOOTSTRAP_RETIRE
    bool "svc/bootstrap-retire (/svc/bootstrap-retire)"
    default y
    depends on SYSTEM_APP_COMPONENT_MANAGER
    help
        Build and deploy hyper-bootstrap-retire at /svc/bootstrap-retire.

config SYSTEM_APP_SVC_JOURNAL
    bool "svc/journal (/svc/journal)"
    default y
    depends on SYSTEM_APP_COMPONENT_MANAGER
    help
        Build and deploy hyper-journald at /svc/journal.

config SYSTEM_APP_SYSTEM_STARTUP
    bool "system-startup (/svc/system-startup)"
    default y
    depends on SYSTEM_APP_COMPONENT_MANAGER && SYSTEM_APP_CONSOLE_RAW_SYSTEM && SYSTEM_APP_SVC_JOURNAL && SYSTEM_APP_SVC_BOOTSTRAP_RETIRE
    help
        Build and deploy hyper-system-startup at /svc/system-startup.

config SYSTEM_APP_TERMINAL_SERVICE
    bool "terminal-service (/svc/terminal-service)"
    default y
    depends on SYSTEM_APP_CONSOLE_RAW_SYSTEM
    help
        Build and deploy hyper-terminal-service at /svc/terminal-service.

config SYSTEM_APP_VM_MANAGER
    bool "vm-manager (/svc/vm-manager)"
    default y
    depends on SYSTEM_APP_VM_RUNTIME && SYSTEM_APP_COMPONENT_MANAGER
    help
        Build and deploy hyper-vm-manager at /svc/vm-manager.

config SYSTEM_APP_VM_RUNTIME
    bool "vm-runtime (/svc/vm-runtime)"
    default y
    depends on SYSTEM_APP_COMPONENT_MANAGER
    help
        Build and deploy hyper-vm-runtime at /svc/vm-runtime.

endmenu
```
